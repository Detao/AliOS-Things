## app/example/IR05F/Config.in
```kconfig
config AOS_APP_IR05F
    bool "IR05F Sample"
    help
        this is a IR05F sample form hal uart.h

if AOS_APP_IR05F
# Configurations for app uart
endif
```

## app/example/tem_hum_monitor/Config.in
```kconfig
config AOS_APP_TEM_HUM_MONITOR
    bool "tem_hum_monitor Application"
    select AOS_COMP_CLI if !AOS_BOARD_ESP8266
    select AOS_COMP_NETMGR
    select AOS_COMP_OTA
    select AOS_COMP_CJSON
    select AOS_COMP_LINKKIT_SDK_C
    select APP_FEATURE_LINKKIT
    select AOS_COMP_CJSON
    select AOS_COMP_BREEZE if LINKKITAPP_CONFIG_COMBOAPP
    select AOS_COMP_BREEZE_HAL if LINKKITAPP_CONFIG_COMBOAPP
    help
        tem_hum_monitor

if AOS_APP_TEM_HUM_MONITOR
# Configurations for app tem_hum_monitor
config TEM_HUM_MONITOR_CONFIG_COMBOAPP
    bool "Enable Breeze AWSS "
    default n
    help 
        Providing secured ble link for wifi provision.

choice
    prompt "Select Case"
    default TEM_HUM_MONITOR_CONFIG_CASE_SOLO
    help
        select case to build

    config TEM_HUM_MONITOR_CONFIG_CASE_SOLO
        bool "SOLO"
        help
            default case, build linkkit_example_solo.c or deprecated/solo.c(when enable deprecated)

    config TEM_HUM_MONITOR_CONFIG_CASE_SCHED
        bool "Sched"
        help
            case sched, build linkkit_example_sched.c or deprecated/sched.c(when enable deprecated)

    config TEM_HUM_MONITOR_CONFIG_CASE_CNTDOWN
        bool "Cntdown"
        help
            case countdown, build linkkit_example_cntdown.c or deprecated/cntdown.c(when enable deprecated)
endchoice

config TEM_HUM_MONITOR_CONFIG_DEPRECATED
    bool "Use Deprecated API"
    default n
    help
    use deprecated api,compatible with aos2.0 and earlier, not recommended

config TEM_HUM_MONITOR_CONFIG_PRINT_HEAP
    bool "Show Free Heap Duration"
    default n
    help
    displays heap space periodically for debug
endif
```

## board/Config.in
```kconfig
menu "BSP         Configuration"
choice
    prompt "Board Selection"

source "board/developerkit/Config.in"
if AOS_BOARD_DEVELOPERKIT
    config AOS_BUILD_BOARD
        default "developerkit"

    source "platform/mcu/stm32l4xx_cube/Config.in"
    source "platform/arch/arm/armv7m/Config.in"
endif


source "board/esp32devkitc/Config.in"
if AOS_BOARD_ESP32DEVKITC
    config AOS_BUILD_BOARD
        default "esp32devkitc"

    source "platform/mcu/esp32/Config.in"
    source "platform/arch/xtensa/lx6/Config.in"
endif

source "board/esp32sram/Config.in"
if AOS_BOARD_ESP32SRAM
    config AOS_BUILD_BOARD
        default "esp32sram"

    source "platform/mcu/esp32/Config.in"
    source "platform/arch/xtensa/lx6/Config.in"
endif

source "board/esp8266/Config.in"
if AOS_BOARD_ESP8266
    config AOS_BUILD_BOARD
        default "esp8266"

    source "platform/mcu/esp8266/Config.in"
    source "platform/arch/xtensa/lx106/Config.in"
endif

source "board/linuxhost/Config.in"
if AOS_BOARD_LINUXHOST
    config AOS_BUILD_BOARD
        default "linuxhost"

    source "platform/mcu/linux/Config.in"
    source "platform/arch/linux/Config.in"
endif

source "board/mk3060/Config.in"
if AOS_BOARD_MK3060
    config AOS_BUILD_BOARD
        default "mk3060"

    source "platform/mcu/moc108/Config.in"
    source "platform/arch/arm/armv5/Config.in"
endif


source "board/stm32f103rb-nucleo/Config.in"
if AOS_BOARD_STM32F103RB_NUCLEO
    config AOS_BUILD_BOARD
        default "stm32f103rb-nucleo"

    source "platform/mcu/stm32f1xx/Config.in"
    source "platform/arch/arm/armv7m/Config.in"
endif



source "board/stm32f429zi-nucleo/Config.in"
if AOS_BOARD_STM32F429ZI_NUCLEO
    config AOS_BUILD_BOARD
        default "stm32f429zi-nucleo"

    source "platform/mcu/stm32f4xx_cube/Config.in"
    source "platform/arch/arm/armv7m/Config.in"
endif

source "board/stm32f103ze-alientek/Config.in"
if AOS_BOARD_STM32F103ZE_ALIENTEK
    config AOS_BUILD_BOARD
        default "stm32f103ze-alientek"
    
    source "platform/mcu/stm32f1xx/Config.in"
    source "platform/arch/arm/armv7m/Config.in"
endif

endchoice

endmenu
```

## board/stm32f103ze-alientek/Config.in
```kconfig
config AOS_BOARD_STM32F103ZE_ALIENTEK
    bool "STM32F103ZE_ALIENTEK"
    select AOS_MCU_STM32F1XX
    select AOS_COMP_KERNEL_INIT
    select AOS_COMP_OSAL_AOS
    help
        **The Stm32f103ze_alientek** performance line microcontroller incorporates the high-performance ARM® Cortex™-M3 32-bit RISC core operating at a 72 MHz frequency, high-speed embedded memories, and an extensive range of enhanced I/Os and peripherals connected to two APB buses. The STM32F103ZE+ offers three 12-bit ADCs, four general-purpose 16- bit timers plus two PWM timers, as well as standard and advanced communication interfaces: up to two I2Cs, three SPIs, two I2Ss, one SDIO, five USARTs, an USB and a CAN.

if AOS_BOARD_STM32F103ZE_ALIENTEK
# Configurations for board stm32f103ze_alientek

endif
```
